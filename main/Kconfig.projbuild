## main/Kconfig.projbuild
```kconfig
menu "App Configuration"

    orsource "$IDF_PATH/examples/common_components/env_caps/$IDF_TARGET/Kconfig.env_caps"

	menu "TASK Configuration"
		config BUTTON_TASK_PRIORITY
		    int "Button Task priority"
			range 0 20
		    default 5
		
		config UART_RX_TASK_PRIORITY
		    int "UART RX Task priority"
			range 0 20
		    default 5
			
		config UART_TX_TASK_PRIORITY
		    int "UART TX Task priority"
			range 0 20
		    default 1

		config COMMAND_HANDLER_TASK_PRIORITY
		    int "Command Handler Task priority"
			range 0 20
		    default 1
		
		config SENSORS_DATA_SYNC_TASK_PRIORITY
		    int "Sensors Dats Sync Task priority"
			range 0 20
		    default 1
	endmenu

	menu "UART Configuration"
		config UART_BAUD_RATE
			int "UART communication speed"
			range 1200 115200
			default 115200
			help
			    UART communication speed.
		
		config UART1_RX_PORT
		    int "UART1 RX port"
		    range ENV_GPIO_RANGE_MIN ENV_GPIO_OUT_RANGE_MAX
		    default 37
	
		config UART1_TX_PORT
		    int "UART1 TX port"
		    range ENV_GPIO_RANGE_MIN ENV_GPIO_OUT_RANGE_MAX
		    default 38

		config UART2_RX_PORT
		    int "UART2 RX port"
		    range ENV_GPIO_RANGE_MIN ENV_GPIO_OUT_RANGE_MAX
		    default 47

		config UART2_TX_PORT
		    int "UART2 TX port"
		    range ENV_GPIO_RANGE_MIN ENV_GPIO_OUT_RANGE_MAX
		    default 48
		
		config UART_RX_BUFFER_SIZE
			int "UART RX buffer size"
			range 256 2048
			default 256
			
		config UART_TX_BUFFER_SIZE
			int "UART TX buffer size"
			range 256 2048
			default 256
	endmenu

	menu "Wi-Fi Configuration"
		config WIFI_SSID
		    string "WiFi SSID"
		    help
		        SSID (network name) you want to connect to.

		config WIFI_PASSWORD
		    string "WiFi Password"
		    help
		        Password of the Wi-Fi network you want to connect to.
		
		config WIFI_CONNECTION_MAX_RETRY
		    int "Max connection retry count"
			default 10
	endmenu

    config INPUT_GPIO
        int "Input GPIO number"
        range ENV_GPIO_RANGE_MIN ENV_GPIO_OUT_RANGE_MAX
        default 5

    config LED_GPIO
        int "LED GPIO number"
		range ENV_GPIO_RANGE_MIN ENV_GPIO_OUT_RANGE_MAX
        default 4
	
	config SENSORS_DATA_SYNC_TIME_MS
	    int "Interval for sensors data syncronization in milliseconds"
		default 60000

endmenu
```
